## firmware/main/Kconfig.projbuild
```kconfig
menu "Kage Eyes"
    config KAGE_EYES_DISPLAY_SH8601
        bool "Drive the Waveshare 1.8in AMOLED (SH8601 / CO5300 over QSPI)"
        default n
        help
            Enable for the real board. Off = stub display port (QEMU / compile-only).
    config KAGE_EYES_TOUCH
        bool "Read the FT3168 capacitive touch (taps / holds)"
        default n
endmenu
```
